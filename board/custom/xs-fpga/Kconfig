## board/custom/xs-fpga/Kconfig
```kconfig
if TARGET_XS_FPGA

config SYS_BOARD
	default "xs-fpga"

config SYS_VENDOR
	default "custom"

config SYS_CPU
	default "generic"

config SYS_CONFIG_NAME
	default "xs-fpga"

config TEXT_BASE
	default 0x81200000 if SPL
	default 0x80000000 if !RISCV_SMODE
	default 0x80200000 if RISCV_SMODE && ARCH_RV64I
	default 0x80400000 if RISCV_SMODE && ARCH_RV32I

config SPL_TEXT_BASE
	default 0x80000000

config SPL_OPENSBI_LOAD_ADDR
	hex
	default 0x80100000

config PRE_CON_BUF_ADDR
	hex
	default 0x81000000

config BOARD_SPECIFIC_OPTIONS
	def_bool y
	select GENERIC_RISCV
	imply XILINX_AXIEMAC
	imply PCI
	imply PCI_XILINX	
	imply SYS_NS16550
	imply SMP
	imply PHY_MARVELL
endif
```

## configs/xs-fpga_defconfig
```kconfig
CONFIG_RISCV=y
CONFIG_SYS_MALLOC_LEN=0x800000
CONFIG_HAS_CUSTOM_SYS_INIT_SP_ADDR=y
CONFIG_CUSTOM_SYS_INIT_SP_ADDR=0x80200000
CONFIG_ENV_SIZE=0x20000
CONFIG_DEFAULT_DEVICE_TREE="xs-fpga"
CONFIG_SYS_LOAD_ADDR=0x80200000
CONFIG_TARGET_XS_FPGA=y
CONFIG_ARCH_RV64I=y
CONFIG_RISCV_SMODE=y
CONFIG_FIT=y
CONFIG_DISTRO_DEFAULTS=y
CONFIG_DISPLAY_CPUINFO=y
CONFIG_DISPLAY_BOARDINFO=y
# CONFIG_BOARD_INIT is not set
CONFIG_CMD_BOOTEFI_SELFTEST=y
CONFIG_CMD_NVEDIT_EFI=y
CONFIG_CMD_SPAWN=y
CONFIG_ENV_RELOC_GD_ENV_ADDR=y
CONFIG_DM_MTD=y
CONFIG_FLASH_SHOW_PROGRESS=0
CONFIG_SYS_MAX_FLASH_BANKS=2
CONFIG_UTHREAD=y
CONFIG_UNIT_TEST=y
CONFIG_BAUDRATE=460800
CONFIG_CMD_PCI=y
CONFIG_E1000=y
CONFIG_USB=y
CONFIG_USB_XHCI_HCD=y
CONFIG_USB_XHCI_PCI=y
CONFIG_USB_EHCI_HCD=y
CONFIG_USB_EHCI_PCI=y
CONFIG_USB_HOST_ETHER=y
CONFIG_USB_ETHER_RTL8152=y
```
