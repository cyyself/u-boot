## arch/mips/mach-trivialmips/Kconfig
```kconfig
menu "TrivialMIPS platforms"
    depends on MACH_TRIVIALMIPS

choice
    prompt "Board select"

config TARGET_TRIVIALMIPS_THINPAD
    bool "Thinpad board 2017"

config TARGET_TRIVIALMIPS_NSCSCC
    bool "NSCSCC board 2019"

config TARGET_CDIM
    bool "CQU Dual Issue Machine SoC (NSCSCC 2022)"

endchoice

source "board/thucst/Kconfig"

source "board/nscscc/Kconfig"

endmenu
```

## board/custom/cdim/Kconfig
```kconfig
if TARGET_CDIM

config SYS_BOARD
    default "cdim"

config SYS_VENDOR
    default "custom"

config SYS_CONFIG_NAME
    default "cdim"

config BOARD_SPECIFIC_OPTIONS # dummy
    def_bool y
    imply XILINX_EMACLITE
    imply PHY_SMSC
    imply SYS_NS16550

endif
```

## board/custom/cyysoc/Kconfig
```kconfig
if TARGET_CYYSOC

config SYS_BOARD
	default "cyysoc"

config SYS_VENDOR
	default "custom"

config SYS_CPU
	default "generic"

config SYS_CONFIG_NAME
	default "cyysoc"

config BOARD_SPECIFIC_OPTIONS
	def_bool y
	select GENERIC_RISCV
	imply XILINX_AXIEMAC
	imply XILINX_UARTLITE
	imply XIP
	imply SMP
	imply PHY_REALTEK
	imply PHY_XILINX
endif

if TARGET_CYYSOC32

config SYS_BOARD
	default "cyysoc"

config SYS_VENDOR
	default "custom"

config SYS_CPU
	default "generic"

config SYS_CONFIG_NAME
	default "cyysoc"

config BOARD_SPECIFIC_OPTIONS # dummy
	def_bool y
	select GENERIC_RISCV
	imply XILINX_AXIEMAC
	imply XILINX_UARTLITE
	imply XIP
	imply SMP
endif
```

## configs/cdim_defconfig
```kconfig
CONFIG_MIPS=y
CONFIG_SYS_HAS_NONCACHED_MEMORY=y
CONFIG_SYS_MALLOC_LEN=0x100000
CONFIG_NR_DRAM_BANKS=1
CONFIG_ENV_SIZE=0x1000
CONFIG_DEFAULT_DEVICE_TREE="cdim"
CONFIG_TEXT_BASE=0x9fc00000
CONFIG_SYS_LOAD_ADDR=0x84000000
CONFIG_HAS_CUSTOM_SYS_INIT_SP_ADDR=y
CONFIG_CUSTOM_SYS_INIT_SP_ADDR=0x87000000
CONFIG_TARGET_CDIM=y
CONFIG_SYS_MIPS_TIMER_FREQ=33333333
CONFIG_MIPS_CACHE_INDEX_BASE=0x80000000
CONFIG_MIPS_RELOCATION_TABLE_SIZE=0x8000
CONFIG_RESTORE_EXCEPTION_VECTOR_BASE=y
CONFIG_MIPS_BOOT_FDT=y
CONFIG_DEBUG_UART=y
CONFIG_FIT=y
# CONFIG_ARCH_FIXUP_FDT_MEMORY is not set
CONFIG_SYS_CONSOLE_INFO_QUIET=y
CONFIG_SYS_BOOTM_LEN=0x2000000
CONFIG_NET_RANDOM_ETHADDR=y
CONFIG_PHY=y
CONFIG_DM_MDIO=y
CONFIG_DM_ETH_PHY=y
# reduce image size
CONFIG_SYS_LONGHELP=n
CONFIG_MTD=n
CONFIG_DISTRO_DEFAULTS=n
CONFIG_REGEX=n
CONFIG_EFI_LOADER=n
CONFIG_PARTITIONS=n
CONFIG_CMD_DHCP=y
CONFIG_CMD_MII=y
CONFIG_CMD_MDIO=y
CONFIG_CMD_PING=y
CONFIG_CMD_2048=y
CONFIG_CMD_NFS=n
CONFIG_CMD_CRC32=n
CONFIG_CMD_LZMADEC=n
CONFIG_CMD_UNLZ4=n
CONFIG_CMD_UNZIP=n
CONFIG_FIT_FULL_CHECK=n
CONFIG_FIT_ENABLE_SHA256_SUPPORT=n
CONFIG_GZIP=n
CONFIG_DM_MMC=n
CONFIG_CMD_LOADB=n
CONFIG_CMD_FDT=n

# early debug uart
CONFIG_DEBUG_UART_BASE=0xbfe40000
CONFIG_DEBUG_UART_CLOCK=100000000
CONFIG_DEBUG_UART_SHIFT=0
CONFIG_BAUDRATE=115200
```

## configs/cyysoc_defconfig
```kconfig
# copied from qemu defconfig
CONFIG_RISCV=y
CONFIG_NR_DRAM_BANKS=1
CONFIG_ENV_SIZE=0x10000
CONFIG_TARGET_CYYSOC=y
CONFIG_ARCH_RV64I=y
# CONFIG_DISTRO_DEFAULTS=y
CONFIG_FIT=y
CONFIG_DISPLAY_CPUINFO=y
CONFIG_DISPLAY_BOARDINFO=y
CONFIG_OF_PRIOR_STAGE=y
CONFIG_SYS_RELOC_GD_ENV_ADDR=y
CONFIG_SYS_LOAD_ADDR=0x80000000
CONFIG_TEXT_BASE=0x60000000
CONFIG_HAS_CUSTOM_SYS_INIT_SP_ADDR=y
CONFIG_CUSTOM_SYS_INIT_SP_ADDR=0x88000000
CONFIG_STANDALONE_LOAD_ADDR=0x80200000
CONFIG_SYS_BOOTM_LEN=0x4000000
CONFIG_TIMESTAMP=y
CONFIG_USE_BOOTARGS=y
CONFIG_BLOCK_CACHE=n

# reduce image size
CONFIG_SYS_LONGHELP=n
CONFIG_MTD=n
CONFIG_DISTRO_DEFAULTS=n
CONFIG_REGEX=n
CONFIG_EFI_LOADER=n
CONFIG_PARTITIONS=n
CONFIG_CMD_NFS=n
CONFIG_CMD_CRC32=n
CONFIG_CMD_LZMADEC=n
CONFIG_CMD_UNLZ4=n
CONFIG_CMD_UNZIP=n
CONFIG_FIT_FULL_CHECK=n
CONFIG_FIT_ENABLE_SHA256_SUPPORT=n
CONFIG_GZIP=n
CONFIG_DM_MMC=n
CONFIG_CMD_LOADB=n
CONFIG_CMD_FDT=n

# early debug uart
CONFIG_DEBUG_UART=y
CONFIG_DEBUG_UART_UARTLITE=y
CONFIG_DEBUG_UART_CLOCK=100000000
CONFIG_DEBUG_UART_BASE=0x60100000
CONFIG_DEBUG_UART_SHIFT=2
CONFIG_BAUDRATE=115200

# axi ethernet driver
CONFIG_DM_ETH=y
CONFIG_DM_MDIO=y
CONFIG_DM_ETH_PHY=y
CONFIG_PHY=y
CONFIG_NET=y
CONFIG_XILINX_AXIEMAC=y
CONFIG_CMD_MII=y
CONFIG_CMD_MDIO=y
CONFIG_CMD_PING=y
CONFIG_PHY_XILINX=y

# use embedded dtb
CONFIG_OF_SEPARATE=y
CONFIG_DEFAULT_DEVICE_TREE="cyysoc"
```
